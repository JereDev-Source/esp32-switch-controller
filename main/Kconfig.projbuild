## main/Kconfig.projbuild
```kconfig
menu "Switch Controller"

config SWITCH_CONTROLLER_BLE_HID
    bool "Use BLE HID transport"
    default y
    help
        Select the BLE HID transport instead of the Bluetooth Classic HIDP
        transport. This is the experimental transport for Nintendo Switch 2.

config SWITCH_CONTROLLER_BTSTACK
    bool "Use vendored BTstack Classic HID"
    default n
    depends on BT_ENABLED
    depends on IDF_TARGET_ESP32
    help
        Use the vendored BTstack Classic HID device implementation. The
        original Bluedroid HIDP implementation remains available when this
        option is disabled.

config BTSTACK_INTERNAL_BT
    bool
    default y if SWITCH_CONTROLLER_BTSTACK

config BTSTACK_EXTERNAL_UART_BT
    bool
    default n

config BTSTACK_AUDIO
    bool
    default n

config BTSTACK_HCI_DUMP_STDOUT
    bool
    default n

endmenu
```

## sdkconfig.defaults
```kconfig
# Classic Bluetooth HIDP profile for an original Nintendo Switch Pro Controller.
CONFIG_BT_ENABLED=y
CONFIG_BT_BLUEDROID_ENABLED=y
CONFIG_BT_CLASSIC_ENABLED=y
CONFIG_BT_BLE_ENABLED=n
CONFIG_BT_NIMBLE_ENABLED=n
CONFIG_BT_HID_ENABLED=y
CONFIG_BT_HID_DEVICE_ENABLED=y
CONFIG_BT_SDP_COMMON_ENABLED=y
CONFIG_BTDM_CTRL_MODE_BR_EDR_ONLY=y
CONFIG_SWITCH_CONTROLLER_BLE_HID=n
CONFIG_LOG_DEFAULT_LEVEL_DEBUG=y
CONFIG_LOG_MAXIMUM_LEVEL_DEBUG=y
CONFIG_FREERTOS_HZ=1000
CONFIG_NVS_ASSERT_ERROR_CHECK=n
CONFIG_PARTITION_TABLE_SINGLE_APP=y
CONFIG_ESP_MAIN_TASK_STACK_SIZE=4096
```

## sdkconfig.defaults.ble
```kconfig
# Experimental BLE HID profile for Switch 2 research.
CONFIG_BT_ENABLED=y
CONFIG_BT_BLUEDROID_ENABLED=y
CONFIG_BT_CLASSIC_ENABLED=n
CONFIG_BT_BLE_ENABLED=y
CONFIG_BT_NIMBLE_ENABLED=n
CONFIG_BTDM_CTRL_MODE_BLE_ONLY=y
CONFIG_BT_SMP_ENABLE=y
CONFIG_GATTS_ENABLE=y
CONFIG_BT_GATTS_SEND_SERVICE_CHANGE_AUTO=y
CONFIG_BT_HID_ENABLED=n
CONFIG_SWITCH_CONTROLLER_BLE_HID=y
CONFIG_SWITCH_CONTROLLER_BTSTACK=n
CONFIG_LOG_DEFAULT_LEVEL_DEBUG=y
CONFIG_LOG_MAXIMUM_LEVEL_DEBUG=y
CONFIG_FREERTOS_HZ=1000
CONFIG_NVS_ASSERT_ERROR_CHECK=n
CONFIG_PARTITION_TABLE_SINGLE_APP=y
CONFIG_ESP_MAIN_TASK_STACK_SIZE=4096
```

## sdkconfig.defaults.btstack
```kconfig
CONFIG_BT_ENABLED=y
CONFIG_BT_BLUEDROID_ENABLED=n
CONFIG_BT_CLASSIC_ENABLED=y
CONFIG_BT_BLE_ENABLED=n
CONFIG_BT_NIMBLE_ENABLED=n
CONFIG_BTDM_CTRL_MODE_BR_EDR_ONLY=y
CONFIG_BTSTACK_INTERNAL_BT=y
CONFIG_BTSTACK_EXTERNAL_UART_BT=n
CONFIG_BTSTACK_AUDIO=n
CONFIG_BTSTACK_HCI_DUMP_STDOUT=n
CONFIG_SWITCH_CONTROLLER_BLE_HID=n
CONFIG_SWITCH_CONTROLLER_BTSTACK=y
CONFIG_BT_SMP_CRYPTO_STACK_TINYCRYPT=y
CONFIG_LOG_DEFAULT_LEVEL_DEBUG=y
CONFIG_FREERTOS_HZ=1000
```
